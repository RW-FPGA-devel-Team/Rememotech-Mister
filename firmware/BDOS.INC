;
; BDOS.INC  Basic BDOS function numbers etc.
;
BDOS	EQU	0005H
TRUE	EQU	0FFFFH
FALSE	EQU	NOT TRUE
K	EQU	1024
CONIN	EQU	1
CONOUT	EQU	2
RDRIN	EQU	3
PUNOUT	EQU	4
LSTOUT	EQU	5
DCONIO	EQU	6
GETIOB	EQU	7
SETIOB	EQU	8
PRINTF	EQU	9
RCBUFF	EQU	10
CONST	EQU	11
RETVER	EQU	12
RESDSC	EQU	13
SELDSC	EQU	14
OPENF	EQU	15
CLOSEF	EQU	16
SFF	EQU	17
SFN	EQU	18
DELFIL	EQU	19
RSEQ	EQU	20
WSEQ	EQU	21
MAKFIL	EQU	22
RENFIL	EQU	23
RETLV	EQU	24
RCDSC	EQU	25
SETDMA	EQU	26
GETAA	EQU	27
WPDSC	EQU	28
GETROV	EQU	29
SFATTR	EQU	30
GETDPB	EQU	31
GSUSR	EQU	32
RRAN	EQU	33
WRAN	EQU	34
CFSIZE	EQU	35
SETRR	EQU	36
RESDRV	EQU	37
WRANF	EQU	40
FCB1	EQU	005CH
FCB2	EQU	006CH
R0	EQU	33
R1	EQU	34
R2	EQU	35

; Last line blank

