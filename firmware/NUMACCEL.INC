;
; Numeric Accelerator equates
;

C_INIT	EQU	000H
C_LIT	EQU	001H
C_DUP	EQU	002H
C_DROP	EQU	003H
C_SWAP	EQU	004H
C_OVER	EQU	005H
C_OK	EQU	006H
C_1	EQU	010H
C_INEG	EQU	020H
C_INOT	EQU	021H
C_ILSL	EQU	022H
C_ILSR	EQU	023H
C_IASR	EQU	024H
C_IABS	EQU	025H
C_ISGN	EQU	026H
C_IADD	EQU	030H
C_ISUB	EQU	031H
C_UMUL	EQU	032H
C_SMUL	EQU	033H
C_UDIV	EQU	034H
C_SDIV	EQU	035H
C_UMOD	EQU	036H
C_SMOD	EQU	037H
C_HMUL	EQU	038H
C_1P0	EQU	040H
C_2P0	EQU	041H
C_10P0	EQU	042H
C_PI	EQU	043H
C_PI2	EQU	044H
C_2PI	EQU	045H
C_R2	EQU	046H
C_R3	EQU	047H
C_R5	EQU	048H
C_R7	EQU	049H
C_R9	EQU	04AH
C_R11	EQU	04BH
C_R13	EQU	04CH
C_R15	EQU	04DH
C_R17	EQU	04EH
C_R3F	EQU	04FH
C_R4F	EQU	050H
C_R5F	EQU	051H
C_R6F	EQU	052H
C_R7F	EQU	053H
C_R8F	EQU	054H
C_R9F	EQU	055H
C_R11F	EQU	056H
C_R13F	EQU	057H
C_L2E	EQU	058H
C_LE2	EQU	059H
C_FNEG	EQU	060H
C_FABS	EQU	061H
C_FSGN	EQU	062H
C_FINT	EQU	063H
C_FADD	EQU	070H
C_FSUB	EQU	071H
C_FMUL	EQU	072H
C_FDIV	EQU	073H
C_UTOF	EQU	080H
C_FTOU	EQU	081H

R_BUSY	EQU	000H
R_OK	EQU	001H
R_DIV0	EQU	002H
R_OVER	EQU	003H
R_UNDR	EQU	004H

