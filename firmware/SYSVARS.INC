;
; MTX BASIC system variables
;

CTRBADR	EQU	0FA52H
LSTPG	EQU	0FA7AH
VARNAM	EQU	0FA7BH
VALBOT	EQU	0FA7DH
CALCBOT	EQU	0FA7FH
CALCST	EQU	0FA81H
KBDBUF	EQU	0FA83H
USER	EQU	0FA89H
IOPL	EQU	0FA8FH
REALBY	EQU	0FA90H
KBFLAG	EQU	0FA91H
STKLIM	EQU	0FA92H
SYSTOP	EQU	0FA94H
SSTACK	EQU	0FA96H
USERINT	EQU	0FA98H
NODLOC	EQU	0FA9BH
FEXPAND	EQU	0FA9EH
USERNOD	EQU	0FAA1H
NBTOP	EQU	0FAA4H
NBTPG	EQU	0FAA6H
BASTOP	EQU	0FAA7H
BASTPG	EQU	0FAA9H
BASBOT	EQU	0FAAAH
BASTPO	EQU	0FAACH
ARRTOP	EQU	0FACCH
BASELIN	EQU	0FACFH
BASLNP	EQU	0FAD1H
PAGE	EQU	0FAD2H
CRNTPG	EQU	0FAD3H
PGN1	EQU	0FAD4H
PGN2	EQU	0FAD5H
PGTOP	EQU	0FAD6H
GOSTACK	EQU	0FAD8H
GOPTR	EQU	0FB41H
GOSNUM	EQU	0FB43H
CTYSLT	EQU	0FB45H
DATAAD	EQU	0FB46H
DATAPG	EQU	0FB48H
DESAVE	EQU	0FB49H
START	EQU	0FB4BH
SETCALL	EQU	0FD48H
RICHJL	EQU	0FD4BH
USRRST	EQU	0FD4EH
USERIO	EQU	0FD51H
USERROR	EQU	0FD54H
CLOCK	EQU	0FD57H
INTFFF	EQU	0FD5EH
CASBAUD	EQU	0FD5FH
MIDVAL	EQU	0FD60H
RETSAVE	EQU	0FD61H
VALZERO	EQU	0FD65H
VERIF	EQU	0FD67H
TYPE	EQU	0FD68H
CONTFLG	EQU	0FD69H
CONTAD	EQU	0FD6AH
CONTPG	EQU	0FD6CH
ASTACK	EQU	0FD6DH
TMPHL	EQU	0FD6FH
TMPA	EQU	0FD71H
STACCT	EQU	0FD73H
PRORPL	EQU	0FD75H
IOPR	EQU	0FD76H
AUTOIN	EQU	0FD77H
AUTOST	EQU	0FD79H
AUTOCT	EQU	0FD7BH
LASTKY	EQU	0FD7CH
LASTASC	EQU	0FD7DH
LASTDR	EQU	0FD7EH
RNSEED	EQU	0FD7FH
BREAK	EQU	0FD81H
COMMAND	EQU	0FD82H
ERRPOS	EQU	0FD84H
FLAGS1	EQU	0FD86H
ITYPE	EQU	0FD87H
MAFD	EQU	0FD89H
MBCD	EQU	0FD8BH
MDED	EQU	0FD8DH
MHLD	EQU	0FD8FH
MAF	EQU	0FD91H
MBC	EQU	0FD93H
MDE	EQU	0FD95H
MHL	EQU	0FD97H
MIX	EQU	0FD99H
MIY	EQU	0FD9BH
MSP	EQU	0FD9DH
MPC	EQU	0FD9FH
MEMPOINT EQU	0FDA1H
WCHJUMP	EQU	0FDA3H
POINTERR EQU	0FDA5H
DADD	EQU	0FDA6H
ASBYTE	EQU	0FDA8H
INDEX	EQU	0FDA9H
DBYTE	EQU	0FDAAH
LINKER	EQU	0FDACH
EDIT	EQU	0FDADH
LENGTH	EQU	0FDAEH
DETYPE	EQU	0FDAFH
DTYPE	EQU	0FDB0H
DISAD	EQU	0FDB1H
DPROG	EQU	0FDB3H
LABTABL	EQU	0FDB5H
APROG	EQU	0FDB7H
ENDTAB	EQU	0FDB9H
COMMENT	EQU	0FDBBH
COMAD	EQU	0FDBCH
ADLABEL	EQU	0FDBEH
INDEXLAB EQU	0FDC1H
DATALAB	EQU	0FDC3H
DBLABEL	EQU	0FDC6H
BASEM	EQU	0FDC7H
CURLAB	EQU	0FDC9H
ACC1	EQU	0FDCCH
INTTAB	EQU	0FDF2H
GASH	EQU	0FE02H
TEMP	EQU	0FE04H
CHAN	EQU	0FE14H
FREQ	EQU	0FE16H
VOL	EQU	0FE18H
WKAREA	EQU	0FE1AH
BSSTR	EQU	0FE3FH
SPEED	EQU	0FE4BH
SPBASE	EQU	0FE4CH
MVDIST	EQU	0FE4DH
NOSPR	EQU	0FE4EH
DLSPNO	EQU	0FE4FH
PLSPNO	EQU	0FE50H
MVNO	EQU	0FE51H
DELSPR	EQU	0FE52H
VCOUNT	EQU	0FE53H
VDPSTS	EQU	0FE54H
SPRTBL	EQU	0FE55H
SMBYTE	EQU	0FF55H
LENLO	EQU	0FF56H
LENHI	EQU	0FF57H
VINTFG	EQU	0FF58H
CHPTR	EQU	0FF59H
SCRN0	EQU	0FF5DH
SCRN1	EQU	0FF6CH
SCRN2	EQU	0FF7BH
SCRN3	EQU	0FF8AH
SCRN4	EQU	0FF99H
SCRN5	EQU	0FFA8H
SCRN6	EQU	0FFB7H
SCRN7	EQU	0FFC6H
USTYPETABLE EQU	0FFD5H
VIRTUALSCN EQU	0FFEDH
OVERLAY	EQU	0FFEEH

;
